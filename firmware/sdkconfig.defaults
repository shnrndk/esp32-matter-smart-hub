## firmware/sdkconfig.defaults
```kconfig
CONFIG_ESPTOOLPY_FLASHSIZE_4MB=y
CONFIG_PARTITION_TABLE_CUSTOM=y
CONFIG_PARTITION_TABLE_FILENAME="partitions.csv"
CONFIG_ENABLE_CHIP_SHELL=y
CONFIG_ESP_MATTER_CONSOLE_TASK_STACK=4096
CONFIG_CHIP_SHELL_CMD_LINE_BUF_MAX_LENGTH=512
CONFIG_LWIP_HOOK_IP6_ROUTE_DEFAULT=y
CONFIG_LWIP_HOOK_ND6_GET_GW_DEFAULT=y
CONFIG_LWIP_IPV6_AUTOCONFIG=y
CONFIG_LWIP_IPV6_NUM_ADDRESSES=6
CONFIG_CHIP_TASK_STACK_SIZE=15360
CONFIG_ESP_MAIN_TASK_STACK_SIZE=10240
CONFIG_NUM_UDP_ENDPOINTS=16
CONFIG_ENABLE_CHIP_CONTROLLER_BUILD=y
CONFIG_ESP_MATTER_CONTROLLER_ENABLE=y
CONFIG_ESP_MATTER_ENABLE_MATTER_SERVER=n
CONFIG_ESP_MATTER_COMMISSIONER_ENABLE=y
CONFIG_MBEDTLS_HKDF_C=y
CONFIG_CHIP_PROJECT_CONFIG="main/matter_project_config.h"
CONFIG_WIFI_NETWORK_COMMISSIONING_DRIVER=n
# Fetch real-device attestation roots rather than using only test roots.
CONFIG_DCL_ATTESTATION_TRUST_STORE=y
# Current classic ESP32 profile uses on-network commissioning.
CONFIG_BT_ENABLED=n
CONFIG_ENABLE_ESP32_BLE_CONTROLLER=n
```
